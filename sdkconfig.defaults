## sdkconfig.defaults
```kconfig
# ============================================================
# Target — set via "idf.py set-target esp32s3" before first build.
# Listed here as a safety fallback.
# ============================================================
CONFIG_IDF_TARGET="esp32s3"

# ============================================================
# Flash  (Waveshare 4.3B: 16 MB QIO @ 80 MHz)
# ============================================================
CONFIG_ESPTOOLPY_FLASHSIZE_16MB=y
CONFIG_ESPTOOLPY_FLASHMODE_QIO=y
CONFIG_ESPTOOLPY_FLASHFREQ_80M=y
CONFIG_PARTITION_TABLE_CUSTOM=y
CONFIG_PARTITION_TABLE_CUSTOM_FILENAME="partitions.csv"

# ============================================================
# PSRAM  (8 MB OPI PSRAM on ESP32-S3)
# ============================================================
CONFIG_SPIRAM=y
CONFIG_SPIRAM_MODE_OCT=y
CONFIG_SPIRAM_SPEED_80M=y
CONFIG_SPIRAM_USE_MALLOC=y
# Allocations <= 16 KB prefer internal SRAM; larger go to PSRAM.
CONFIG_SPIRAM_MALLOC_ALWAYSINTERNAL=16384
# Reserve 128 KB of internal SRAM for DMA / MALLOC_CAP_INTERNAL use.
# Budget: LCD bounce buffers (2×10×800×2 = 32 KB)
#       + Wi-Fi static RX    (6×1600     =  9.6 KB)
#       + Wi-Fi mgmt/TX/DMA internals   ~ 55 KB
#       + DMA descriptors + headroom    ~ 31 KB
CONFIG_SPIRAM_MALLOC_RESERVE_INTERNAL=131072
CONFIG_SPIRAM_TRY_ALLOCATE_WIFI_LWIP=y
CONFIG_SPIRAM_ALLOW_STACK_EXTERNAL_MEMORY=y

# ============================================================
# CPU  (240 MHz dual-core)
# ============================================================
CONFIG_ESP32S3_DEFAULT_CPU_FREQ_240=y

# ============================================================
# FreeRTOS
# ============================================================
CONFIG_FREERTOS_HZ=1000

# ============================================================
# Logging
# ============================================================
CONFIG_LOG_DEFAULT_LEVEL_INFO=y
CONFIG_LOG_MAXIMUM_LEVEL_DEBUG=y

# ============================================================
# Wi-Fi  (ESP-IDF v5.x naming convention)
# ============================================================
# Reduced from 16 → 10 → 6 to ease DMA SRAM pressure (saves 6.4 KB vs 10).
# Dynamic RX buffers (heap, can use PSRAM via SPIRAM_TRY_ALLOCATE_WIFI_LWIP)
# handle burst traffic above the static count.
CONFIG_ESP_WIFI_STATIC_RX_BUFFER_NUM=6
CONFIG_ESP_WIFI_DYNAMIC_RX_BUFFER_NUM=64
CONFIG_ESP_WIFI_DYNAMIC_TX_BUFFER=y
CONFIG_ESP_WIFI_TX_BUFFER_TYPE=1
CONFIG_ESP_WIFI_DYNAMIC_TX_BUFFER_NUM=32
# RX Block-Ack window must satisfy: RX_BA_WIN <= 2 × STATIC_RX_BUFFER_NUM.
# With STATIC_RX_BUFFER_NUM=6 the ceiling is 12; default in ESP-IDF v5.5 is 16.
# Set to 6 to stay safely within the limit.
CONFIG_ESP_WIFI_RX_BA_WIN=6
CONFIG_ESP_WIFI_AMPDU_TX_ENABLED=y
CONFIG_ESP_WIFI_AMPDU_RX_ENABLED=y

# ============================================================
# Compiler  (-O2 optimisation)
# ============================================================
CONFIG_COMPILER_OPTIMIZATION_PERF=y

# ============================================================
# NVS encryption (off for development; enable in production)
# ============================================================
CONFIG_NVS_ENCRYPTION=n

# ============================================================
# LVGL  (managed component — see main/idf_component.yml)
# Color depth must match the RGB565 panel data width.
# ============================================================
CONFIG_LV_COLOR_DEPTH=16

# Montserrat fonts used by the HMI UI.
# Enable all three sizes that hmi_main.c and screens reference.
CONFIG_LV_FONT_MONTSERRAT_12=y
CONFIG_LV_FONT_MONTSERRAT_14=y
CONFIG_LV_FONT_MONTSERRAT_28=y
```
